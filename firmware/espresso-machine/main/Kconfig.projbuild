## firmware/espresso-machine/main/Kconfig.projbuild
```kconfig
menu "PhilcoINO"

    config PHILCOINO_WIFI_SSID
        string "Wi-Fi SSID"
        default ""
        help
            Stored only in the generated, ignored sdkconfig file. Never add the
            actual value to sdkconfig.defaults or source files.

    config PHILCOINO_WIFI_PASSWORD
        string "Wi-Fi password"
        default ""
        help
            Stored only in the generated, ignored sdkconfig file. Never log it.

    config PHILCOINO_PAIRING_CODE
        string "Pairing code (exactly 8 digits)"
        default ""
        help
            Unique provisioned eight-digit numeric code, including any leading
            zeroes. Stored only in the generated, ignored sdkconfig file. The
            build rejects values that are not exactly eight digits. Never log it.

    config PHILCOINO_RAW_TEMPERATURE_LOGGING
        bool "Log raw boiler Celsius samples to the serial monitor"
        default n
        help
            Logs each valid, uncalibrated MAX6675 boiler sample at INFO level
            after the temperature controller update completes. This diagnostic
            option does not change control inputs or outputs. Keep it disabled
            in normal builds because serial logging can affect task timing.

    config PHILCOINO_RAW_SCALE_LOGGING
        bool "Log rate-limited raw HX711 samples to the serial monitor"
        default n
        help
            Logs valid HX711 raw samples at no more than four lines per second,
            immediate transport and saturation failures, and data-ready outages
            only after the normal availability timeout. Each valid log includes
            the change since the previous logged raw sample; failure logs include
            time since the last valid sample. This diagnostic does not change
            scale filtering, availability, calibration, or control. Keep it
            disabled in normal builds because serial logging can affect task
            timing.

endmenu
```

## firmware/espresso-machine/sdkconfig.defaults
```kconfig
CONFIG_PARTITION_TABLE_CUSTOM=y
CONFIG_PARTITION_TABLE_CUSTOM_FILENAME="partitions.csv"
CONFIG_COMPILER_CXX_EXCEPTIONS=n
CONFIG_COMPILER_CXX_RTTI=n
CONFIG_LOG_DEFAULT_LEVEL_INFO=y
CONFIG_LOG_MAXIMUM_LEVEL_INFO=y
CONFIG_ESP_MAIN_TASK_STACK_SIZE=4096
CONFIG_ESP_MAIN_TASK_AFFINITY_CPU1=y
CONFIG_ESP_WIFI_TASK_PINNED_TO_CORE_0=y
CONFIG_LWIP_TCPIP_TASK_AFFINITY_CPU0=y
CONFIG_ESP_TIMER_SUPPORTS_ISR_DISPATCH_METHOD=y
CONFIG_GPTIMER_ISR_CACHE_SAFE=y
CONFIG_GPIO_CTRL_FUNC_IN_IRAM=y
CONFIG_FREERTOS_IN_IRAM=y
CONFIG_MBEDTLS_X509_CREATE_C=y
CONFIG_MBEDTLS_X509_CRT_WRITE_C=y
CONFIG_ESPTOOLPY_FLASHSIZE_16MB=y
CONFIG_ESPTOOLPY_FLASHMODE_QIO=y
CONFIG_ESPTOOLPY_FLASHFREQ_80M=y
CONFIG_ESP_CONSOLE_USB_SERIAL_JTAG=y
# CONFIG_SPIRAM is not set
CONFIG_PARTITION_TABLE_SINGLE_APP=n
CONFIG_BOOTLOADER_APP_ROLLBACK_ENABLE=y
```
